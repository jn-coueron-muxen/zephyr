## drivers/display/Kconfig.hx8379
```kconfig
# HX8379 display driver configuration options

# SPDX-License-Identifier: Apache-2.0

config HX8379
	bool "HX8379 display driver"
	default y
	select MIPI_DSI
	depends on DT_HAS_HIMAX_HX8379_ENABLED
	help
	  Enable driver for HX8379 display driver.

if HX8379

config DISPLAY_HX8379_INIT_PRIORITY
	int "Initialization priority"
	default DISPLAY_INIT_PRIORITY
	help
	  HX8379 display driver initialization priority.

endif
```

## dts/bindings/display/himax,hx8379.yaml
```yaml
#
# SPDX-License-Identifier: Apache-2.0
#

description: Himax HX8379 Panel

compatible: "himax,hx8379"

include: [mipi-dsi-device.yaml, display-controller.yaml]

properties:
  reset-gpios:
    type: phandle-array
    description: |
      The RESX pin is asserted to disable the sensor causing a hard
      reset.  The sensor receives this as an active-low signal.

  bl-gpios:
    type: phandle-array
    description: |
      The BLn pin is asserted to control the backlight of the panel.
      The sensor receives this as an active-high signal.

  rotation:
    type: int
    default: 0
    enum:
      - 0
      - 90
      - 180
      - 270
    description: |
      Display rotation (CW) in degrees. Defaults to 0, display default.
```
